## nerves_defconfig
```kconfig
BR2_aarch64=y
BR2_ARM_FPU_VFPV4=y
BR2_TOOLCHAIN_EXTERNAL=y
BR2_TOOLCHAIN_EXTERNAL_CUSTOM=y
BR2_TOOLCHAIN_EXTERNAL_DOWNLOAD=y
BR2_TOOLCHAIN_EXTERNAL_URL="https://github.com/nerves-project/toolchains/releases/download/v1.8.0/nerves_toolchain_aarch64_nerves_linux_gnu-linux_${shell uname -m}-1.8.0-E9F5B2A.tar.xz"
BR2_TOOLCHAIN_EXTERNAL_CUSTOM_PREFIX="aarch64-nerves-linux-gnu"
BR2_TOOLCHAIN_EXTERNAL_GCC_12=y
BR2_TOOLCHAIN_EXTERNAL_HEADERS_4_19=y
BR2_TOOLCHAIN_EXTERNAL_CUSTOM_GLIBC=y
# BR2_TOOLCHAIN_EXTERNAL_INET_RPC is not set
BR2_TOOLCHAIN_EXTERNAL_CXX=y
BR2_TOOLCHAIN_EXTERNAL_FORTRAN=y
BR2_TOOLCHAIN_EXTERNAL_OPENMP=y
BR2_TAR_OPTIONS="--no-same-owner"
BR2_BACKUP_SITE="http://dl.nerves-project.org"
BR2_ENABLE_DEBUG=y
BR2_OPTIMIZE_2=y
BR2_GLOBAL_PATCH_DIR="${BR2_EXTERNAL_NERVES_PATH}/patches ${NERVES_DEFCONFIG_DIR}/patches"
BR2_REPRODUCIBLE=y
BR2_ROOTFS_SKELETON_CUSTOM=y
BR2_ROOTFS_SKELETON_CUSTOM_PATH="${BR2_EXTERNAL_NERVES_PATH}/board/nerves-common/skeleton"
BR2_INIT_NONE=y
BR2_ROOTFS_DEVICE_TABLE="${BR2_EXTERNAL_NERVES_PATH}/board/nerves-common/device_table.txt"
BR2_ENABLE_LOCALE_WHITELIST="locale-archive"
BR2_GENERATE_LOCALE="en_US.UTF-8"
BR2_ROOTFS_OVERLAY="${BR2_EXTERNAL_NERVES_PATH}/board/nerves-common/rootfs_overlay ${NERVES_DEFCONFIG_DIR}/rootfs_overlay"
BR2_ROOTFS_POST_BUILD_SCRIPT="${NERVES_DEFCONFIG_DIR}/post-build.sh ${BR2_EXTERNAL_NERVES_PATH}/board/nerves-common/post-build.sh"
BR2_ROOTFS_POST_IMAGE_SCRIPT="${NERVES_DEFCONFIG_DIR}/post-createfs.sh"
BR2_LINUX_KERNEL=y
BR2_LINUX_KERNEL_CUSTOM_GIT=y
BR2_LINUX_KERNEL_CUSTOM_REPO_URL="https://git.ti.com/git/ti-linux-kernel/ti-linux-kernel.git"
BR2_LINUX_KERNEL_CUSTOM_REPO_VERSION="09.01.00.003"
BR2_LINUX_KERNEL_PATCH="${NERVES_DEFCONFIG_DIR}/linux"
BR2_LINUX_KERNEL_USE_CUSTOM_CONFIG=y
BR2_LINUX_KERNEL_CUSTOM_CONFIG_FILE="${NERVES_DEFCONFIG_DIR}/linux/linux-6.1.defconfig"
BR2_LINUX_KERNEL_XZ=y
BR2_LINUX_KERNEL_DTS_SUPPORT=y
BR2_LINUX_KERNEL_INTREE_DTS_NAME="ti/k3-am625-sk"
BR2_LINUX_KERNEL_INSTALL_TARGET=y
BR2_LINUX_KERNEL_NEEDS_HOST_OPENSSL=y
BR2_PACKAGE_BUSYBOX_CONFIG="${BR2_EXTERNAL_NERVES_PATH}/board/nerves-common/busybox.config"
BR2_PACKAGE_ALSA_UTILS=y
# BR2_PACKAGE_ALSA_UTILS_ALSAMIXER is not set
BR2_PACKAGE_ALSA_UTILS_AMIXER=y
BR2_PACKAGE_ALSA_UTILS_APLAY=y
BR2_PACKAGE_F2FS_TOOLS=y
# BR2_PACKAGE_RNG_TOOLS_JITTERENTROPY_LIBRARY is not set
# BR2_PACKAGE_ALSA_LIB_RAWMIDI is not set
# BR2_PACKAGE_ALSA_LIB_HWDEP is not set
# BR2_PACKAGE_ALSA_LIB_SEQ is not set
# BR2_PACKAGE_ALSA_LIB_ALISP is not set
# BR2_PACKAGE_ALSA_LIB_OLD_SYMBOLS is not set
BR2_PACKAGE_LIBP11=y
BR2_PACKAGE_UNIXODBC=y
BR2_PACKAGE_DTC=y
BR2_PACKAGE_LIBMNL=y
BR2_PACKAGE_WIRELESS_REGDB=y
BR2_PACKAGE_WPA_SUPPLICANT=y
BR2_PACKAGE_WPA_SUPPLICANT_AP_SUPPORT=y
BR2_PACKAGE_WPA_SUPPLICANT_MESH_NETWORKING=y
BR2_PACKAGE_WPA_SUPPLICANT_AUTOSCAN=y
BR2_PACKAGE_WPA_SUPPLICANT_HOTSPOT=y
BR2_PACKAGE_WPA_SUPPLICANT_DEBUG_SYSLOG=y
BR2_PACKAGE_WPA_SUPPLICANT_WPS=y
BR2_PACKAGE_WPA_SUPPLICANT_WPA3=y
BR2_PACKAGE_WPA_SUPPLICANT_CTRL_IFACE=y
# BR2_TARGET_ROOTFS_TAR is not set
BR2_TARGET_ARM_TRUSTED_FIRMWARE=y
BR2_TARGET_ARM_TRUSTED_FIRMWARE_CUSTOM_GIT=y
BR2_TARGET_ARM_TRUSTED_FIRMWARE_CUSTOM_REPO_URL="https://git.trustedfirmware.org/TF-A/trusted-firmware-a.git"
BR2_TARGET_ARM_TRUSTED_FIRMWARE_CUSTOM_REPO_VERSION="d7a7135d32a8c7da004c0c19b75bd4e2813f9759"
BR2_TARGET_ARM_TRUSTED_FIRMWARE_PLATFORM="k3"
BR2_TARGET_ARM_TRUSTED_FIRMWARE_TARGET_BOARD="lite"
BR2_TARGET_ARM_TRUSTED_FIRMWARE_BL32_OPTEE=y
BR2_TARGET_ARM_TRUSTED_FIRMWARE_DEBUG=y
BR2_TARGET_OPTEE_OS=y
BR2_TARGET_OPTEE_OS_CUSTOM_TARBALL=y
BR2_TARGET_OPTEE_OS_CUSTOM_TARBALL_LOCATION="https://github.com/OP-TEE/optee_os/archive/refs/tags/4.0.0.tar.gz"
BR2_TARGET_OPTEE_OS_NEEDS_PYTHON_CRYPTOGRAPHY=y
BR2_TARGET_OPTEE_OS_PLATFORM="k3"
BR2_TARGET_UBOOT=y
BR2_TARGET_UBOOT_BUILD_SYSTEM_KCONFIG=y
BR2_TARGET_UBOOT_CUSTOM_GIT=y
BR2_TARGET_UBOOT_CUSTOM_REPO_URL="https://git.ti.com/git/ti-u-boot/ti-u-boot.git"
BR2_TARGET_UBOOT_CUSTOM_REPO_VERSION="09.01.00.003"
BR2_TARGET_UBOOT_PATCH="${NERVES_DEFCONFIG_DIR}/uboot"
BR2_TARGET_UBOOT_USE_CUSTOM_CONFIG=y
BR2_TARGET_UBOOT_CUSTOM_CONFIG_FILE="${NERVES_DEFCONFIG_DIR}/uboot/uboot.defconfig"
BR2_TARGET_UBOOT_NEEDS_DTC=y
BR2_TARGET_UBOOT_NEEDS_PYLIBFDT=y
BR2_TARGET_UBOOT_NEEDS_OPENSSL=y
BR2_TARGET_UBOOT_NEEDS_ATF_BL31=y
# BR2_TARGET_UBOOT_FORMAT_BIN is not set
BR2_TARGET_UBOOT_FORMAT_IMG=y
BR2_TARGET_UBOOT_SPL=y
BR2_TARGET_UBOOT_SPL_NAME="tispl.bin"
BR2_TARGET_UBOOT_CUSTOM_MAKEOPTS="BINMAN_INDIRS=$(BINARIES_DIR) TEE=$(BINARIES_DIR)/tee-pager_v2.bin"
BR2_PACKAGE_HOST_SWIG=y
BR2_PACKAGE_HOST_UBOOT_TOOLS=y
BR2_PACKAGE_HOST_UBOOT_TOOLS_FIT_SUPPORT=y
BR2_PACKAGE_HOST_UBOOT_TOOLS_ENVIMAGE=y
BR2_PACKAGE_HOST_UBOOT_TOOLS_ENVIMAGE_SOURCE="${NERVES_DEFCONFIG_DIR}/uboot/uboot.env"
BR2_PACKAGE_HOST_UBOOT_TOOLS_ENVIMAGE_SIZE="131072"
BR2_NERVES_SYSTEM_NAME="nerves_system_ti_am62x"
BR2_NERVES_ADDITIONAL_IMAGE_FILES="${NERVES_DEFCONFIG_DIR}/fwup.conf"
BR2_PACKAGE_NBTTY=y
BR2_PACKAGE_NERVES_CONFIG=y
BR2_PACKAGE_TI_K3_R5_LOADER_NEXT=y
BR2_PACKAGE_TI_K3_R5_LOADER_NEXT_CUSTOM_TARBALL=y
BR2_PACKAGE_TI_K3_R5_LOADER_NEXT_CUSTOM_TARBALL_LOCATION="https://git.ti.com/cgit/ti-u-boot/ti-u-boot/snapshot/ti-u-boot-09.01.00.003.tar.gz"
BR2_PACKAGE_TI_K3_R5_LOADER_NEXT_BOARD_DEFCONFIG="am62x_evm_r5"
BR2_PACKAGE_HOST_TI_K3_SECDEV=y
```

## package/python-jsonschema2/Config.in
```kconfig
config BR2_PACKAGE_PYTHON_JSONSCHEMA2
	bool "python-jsonschema"
	select BR2_PACKAGE_PYTHON_ATTRS # runtime
	select BR2_PACKAGE_PYTHON_PYRSISTENT # runtime
	help
	  An implementation of JSON Schema validation for Python.

	  http://github.com/Julian/jsonschema
```

## package/python-pyrsistent2/Config.in
```kconfig
config BR2_PACKAGE_PYTHON_PYRSISTENT2
	bool "python-pyrsistent"
	help
	  Persistent/Functional/Immutable data structures.

	  http://github.com/tobgu/pyrsistent/
```

## package/ti-k3-image-gen/Config.in
```kconfig
config BR2_PACKAGE_TI_K3_IMAGE_GEN
	bool "System firmware and configuration image generator for TI K3 SoCs"
	depends on BR2_PACKAGE_TI_K3_R5_LOADER_NEXT
	help
	  Use TI's k3-image-gen to build a separate bare metal
	  boot binary from a separate SPL that is running on
	  the R5 core. Currently supports version 08.06.00.007
	  as default.

	  https://git.ti.com/cgit/k3-image-gen/k3-image-gen/

if BR2_PACKAGE_TI_K3_IMAGE_GEN
choice
	prompt "SoC firmware type for image gen"
	default BR2_PACKAGE_TI_K3_IMAGE_GEN_FW_TYPE_TIFS

config BR2_PACKAGE_TI_K3_IMAGE_GEN_FW_TYPE_TIFS
	bool "Firmware type TIFS"
	help
	  Use firmware type TIFS for SoCs like AM62x and
	  AM62Ax.

config BR2_PACKAGE_TI_K3_IMAGE_GEN_FW_TYPE_TISCI
	bool "Firmware type TISCI"
	help
	  Use firmware type TISCI for SoCs like AM64x and
	  AM65x.

endchoice

config BR2_PACKAGE_TI_K3_IMAGE_GEN_SOC
	string "SoC"
	help
	  The target SoC option for image gen.
	  For example, "am64x" for AM64x boards.

config BR2_PACKAGE_TI_K3_IMAGE_GEN_SOC_TYPE
	string "security type"
	help
	  The target SoC security type option for image gen.
	  Valid options are "gp" for General Purpose devices,
	  "hs-fs" for High Security - Field Securable devices, or
	  "hs" for High Security - Security Enforcing devices.
	  Note for all High Security device variants the
	  TI_SECURE_DEV_PKG environmental variable must be defined
	  at build time pointing to a valid core-secdev-k3 folder
	  location, otherwise the build will fail, see
	  https://git.ti.com/cgit/security-development-tools/core-secdev-k3

config BR2_PACKAGE_TI_K3_IMAGE_GEN_CONFIG
	string "config type"
	help
	  The board config option for image gen.
	  Usually "sk" or "evm".
endif
```

## package/ti-k3-r5-loader-next/Config.in
```kconfig
config BR2_PACKAGE_TI_K3_R5_LOADER_NEXT
	bool "ti-k3-r5-loader"
	depends on BR2_aarch64
	help
	  Separate U-Boot build for R5 cores on TI's k3 boards.
	  Usually used to build tiboot3.bin with k3-image-gen.

config BR2_PACKAGE_TI_K3_R5_LOADER_NEXT_BOARD_DEFCONFIG
	string "Board defconfig"
	depends on BR2_PACKAGE_TI_K3_R5_LOADER_NEXT
	help
	  Name of the board for which TI K3 R5 Loader should be
	  built, without the _defconfig suffix.
```

## package/ti-k3-secdev/Config.in
```kconfig
config BR2_PACKAGE_HOST_TI_K3_SECDEV
	bool "host ti-k3-secdev"
	help
	  Security development tools for High-Security(HS) TI K3 processors
```

## package/ti-linux-fw/Config.in
```kconfig
config BR2_TARGET_TI_K3_FW
	bool "TI Linux Firmware"
	select BR2_TARGET_TI_K3_R5_LOADER
```
