## linux/linux-5.10.defconfig
```kconfig
CONFIG_ARCH_ACTIONS=n
CONFIG_ARCH_SUNXI=n
CONFIG_ARCH_AGILEX=n
CONFIG_ARCH_ALPINE=n
CONFIG_ARCH_BCM2835=n
CONFIG_ARCH_BCM_IPROC=n
CONFIG_ARCH_BERLIN=n
CONFIG_ARCH_BRCMSTB=n
CONFIG_ARCH_EXYNOS=n
CONFIG_ARCH_LAYERSCAPE=n
CONFIG_ARCH_LG1K=n
CONFIG_ARCH_HISI=n
CONFIG_ARCH_MEDIATEK=n
CONFIG_ARCH_MESON=n
CONFIG_ARCH_MVEBU=n
CONFIG_ARCH_MXC=n
CONFIG_ARCH_QCOM=n
CONFIG_ARCH_ROCKCHIP=n
CONFIG_ARCH_SEATTLE=n
CONFIG_ARCH_RENESAS=n
CONFIG_ARCH_R8A7795=n
CONFIG_ARCH_R8A7796=n
CONFIG_ARCH_S32=n
CONFIG_ARCH_STRATIX10=n
CONFIG_ARCH_SYNQUACER=n
CONFIG_ARCH_TEGRA=n
CONFIG_ARCH_SPRD=n
CONFIG_ARCH_THUNDER=n
CONFIG_ARCH_THUNDER2=n
CONFIG_ARCH_UNIPHIER=n
CONFIG_ARCH_VEXPRESS=n
CONFIG_ARCH_VISCONTI=n
CONFIG_ARCH_XGENE=n
CONFIG_ARCH_ZX=n
CONFIG_ARCH_ZYNQMP=n
CONFIG_ARCH_TEGRA_132_SOC=n
CONFIG_ARCH_TEGRA_210_SOC=n
CONFIG_ARCH_TEGRA_186_SOC=n

CONFIG_QCOM_FALKOR_ERRATUM_1003=n
CONFIG_QCOM_FALKOR_ERRATUM_1009=n
CONFIG_QCOM_QDF2400_ERRATUM_0065=n
CONFIG_QCOM_FALKOR_ERRATUM_E1041=n

CONFIG_CAVIUM_ERRATUM_22375=n
CONFIG_CAVIUM_ERRATUM_23144=n
CONFIG_CAVIUM_ERRATUM_23154=n
CONFIG_CAVIUM_ERRATUM_27456=n
CONFIG_CAVIUM_ERRATUM_30115=n

CONFIG_HISILICON_ERRATUM_161600802=n

CONFIG_SERIAL_8250_FSL=n
CONFIG_SERIAL_8250_DW=n
CONFIG_SERIAL_AMBA_PL011=n
CONFIG_SERIAL_AMBA_PL011_CONSOLE=n
CONFIG_SERIAL_XILINX_PS_UART=n
CONFIG_SERIAL_XILINX_PS_UART_CONSOLE=n

CONFIG_ARM_SCPI_PROTOCOL=n
CONFIG_ARM_SCPI_POWER_DOMAIN=n
CONFIG_ARM_SCPI_CPUFREQ=n
CONFIG_SENSORS_ARM_SCPI=n
CONFIG_COMMON_CLK_SCPI=n

CONFIG_ARM_MHU=n
CONFIG_PLATFORM_MHU=n

CONFIG_ACPI=n

CONFIG_NUMA=n

CONFIG_XEN=n
CONFIG_KVM=n

CONFIG_ARM_BIG_LITTLE_CPUFREQ=n

CONFIG_PCI_XGENE=n
CONFIG_PCI_HISI=n
CONFIG_PCIE_KIRIN=n

# DRM
CONFIG_DRM_NOUVEAU=n
CONFIG_DRM_I2C_ADV7511=n
CONFIG_DRM_ETNAVIV=n
CONFIG_DRM_HISI_HIBMC=n
CONFIG_DRM_HISI_KIRIN=n
CONFIG_DRM_MXSFB=n
CONFIG_DRM_PL111=n
CONFIG_DRM_LIMA=n
CONFIG_DRM_PANFROST=n

# Video
CONFIG_VGA_ARB=n
CONFIG_FB_EFI=n

# V4L2
CONFIG_RC_CORE=n

# Sound
CONFIG_SND_SPI=n
CONFIG_SND_SOC_FSL_SAI=n
CONFIG_SND_SOC_AK4613=n
CONFIG_SND_SOC_ES7134=n
CONFIG_SND_SOC_ES7241=n
CONFIG_SND_SOC_PCM3168A_I2C=n
CONFIG_SND_SOC_TAS571X=n

##################################################
# TI Baseport Config Options
##################################################

# Serial
CONFIG_SERIAL_8250_NR_UARTS=10
CONFIG_SERIAL_8250_RUNTIME_UARTS=10

# K3 Power config options
CONFIG_PM=y

# CPU Idle
CONFIG_CPU_IDLE=y

# ARM CPU Idle Drivers
CONFIG_ARM_CPUIDLE=y
CONFIG_ARM_PSCI_CPUIDLE=n

# CPU Frequency scaling
CONFIG_CPU_FREQ_DEFAULT_GOV_PERFORMANCE=y

# Enable Reset Controllers
CONFIG_RESET_CONTROLLER=y
CONFIG_RESET_TI_SYSCON=y

# Enable support for perf
CONFIG_PERF_EVENTS=y

# Add Bin2c
CONFIG_BUILD_BIN2C=y

# Add base Cgroups functions
CONFIG_CGROUPS=y

# Choose CONFIG_EMBEDDED
CONFIG_EMBEDDED=y

# Enable all kernel symbols please
CONFIG_KALLSYMS=y
CONFIG_KALLSYMS_ALL=y

# How do we want kernel Modules to work?
CONFIG_MODULE_FORCE_LOAD=y
CONFIG_MODULE_FORCE_UNLOAD=y
CONFIG_MODVERSIONS=y
CONFIG_MODULE_SRCVERSION_ALL=y

# Boot options
CONFIG_CRASH_DUMP=n

# Mem allocator
CONFIG_SLUB_DEBUG=n

# Pinctrl
CONFIG_PINCTRL=y
CONFIG_PINCTRL_SINGLE=y

# GPIO
CONFIG_GPIO_SYSFS=y

# Crypto SA2UL
CONFIG_CRYPTO_DEV_SA2UL=m

# Enable options to facilitate testing
CONFIG_CRYPTO_TEST=m

# Thermal
CONFIG_K3_THERMAL=y

# Disable extra debug options
CONFIG_PROFILING=n

# Block Layer
CONFIG_BLK_DEV_RAM=y

# PMIC
CONFIG_MFD_PALMAS=y
CONFIG_REGULATOR=y
CONFIG_REGULATOR_PALMAS=y

# Watchdog support
CONFIG_K3_RTI_WATCHDOG=m

# RTC Drivers
CONFIG_RTC_DRV_TI_K3=y

# Counter device
CONFIG_COUNTER=m

# UIO and overlay support for Jailhouse
CONFIG_UIO=y
CONFIG_OF_OVERLAY=y

# DMA-BUF Heaps
CONFIG_DMABUF_HEAPS=y
CONFIG_DMABUF_HEAPS_SYSTEM=y
CONFIG_DMABUF_HEAPS_CMA=y
CONFIG_DMABUF_HEAPS_CARVEOUT=y
CONFIG_SRAM_DMA_HEAP=y

# DMA-BUF exporter
CONFIG_DMA_BUF_PHYS=y

# TI PAT
CONFIG_TI_PAT=y

# Enable Staging drivers for ARMV8
CONFIG_STAGING=y

# MCRC and its userspace support
CONFIG_CRYPTO_DEV_TI_MCRC64=m
CONFIG_CRYPTO_USER_API_HASH=m

##################################################
# TI Connectivity Configs
##################################################

# Disable unused I2C options
CONFIG_I2C_MUX=n
CONFIG_I2C_DESIGNWARE_PLATFORM=n
CONFIG_I2C_GPIO=n
CONFIG_I2C_RK3X=n
CONFIG_I2C_XILINX=n

# I2C controllers
CONFIG_I2C=y
CONFIG_I2C_OMAP=y

# I2C GPIO expanders
CONFIG_GPIO_PCA953X=y
CONFIG_GPIO_PCA953X_IRQ=y
CONFIG_GPIO_PCF857X=y
CONFIG_GPIO_TPIC2810=m

#I2C EEPROMS
CONFIG_EEPROM_AT24=m

#SPI EEPROMS
CONFIG_EEPROM_93XX46=m

# PTP
CONFIG_PTP_1588_CLOCK=y

#Networking drivers
CONFIG_NET_VENDOR_TI=y
CONFIG_KEYSTONE_NAVIGATOR_QMSS=y
CONFIG_KEYSTONE_NAVIGATOR_DMA=y
CONFIG_TI_KEYSTONE_NETCP=y
CONFIG_TI_KEYSTONE_NETCP_ETHSS=y
CONFIG_TI_DAVINCI_EMAC=y
CONFIG_TI_DAVINCI_MDIO=y
CONFIG_MDIO_BITBANG=y
CONFIG_MDIO_GPIO=y
CONFIG_TI_CPSW=y
CONFIG_TI_CPSW_SWITCHDEV=y
CONFIG_TI_CPTS=y
CONFIG_TI_RDEV_ETH_SWITCH_VIRT_EMAC=m
CONFIG_TI_PRUETH=m
CONFIG_TI_ICSSG_PRUETH=m
CONFIG_TI_K3_AM65_CPSW_SWITCHDEV=y
# non-TI Net vendors
CONFIG_NET_DSA_BCM_SF2=n
CONFIG_B53=n
CONFIG_SYSTEMPORT=n
CONFIG_NET_VENDOR_3COM=n
CONFIG_NET_VENDOR_ADAPTEC=n
CONFIG_NET_VENDOR_AGERE=n
CONFIG_NET_VENDOR_ALTEON=n
CONFIG_NET_VENDOR_AMAZON=n
CONFIG_NET_VENDOR_AMD=n
CONFIG_NET_VENDOR_ARC=n
CONFIG_NET_VENDOR_ATHEROS=n
CONFIG_NET_VENDOR_BROCADE=n
CONFIG_NET_VENDOR_CAVIUM=n
CONFIG_NET_VENDOR_CHELSIO=n
CONFIG_BCMGENET=n
CONFIG_NET_VENDOR_CIRRUS=n
CONFIG_NET_VENDOR_CISCO=n
CONFIG_NET_VENDOR_DEC=n
CONFIG_NET_VENDOR_DLINK=n
CONFIG_NET_VENDOR_EMULEX=n
CONFIG_NET_VENDOR_EZCHIP=n
CONFIG_NET_VENDOR_FARADAY=n
CONFIG_NET_VENDOR_HISILICON=n
CONFIG_NET_VENDOR_HP=n
CONFIG_IGB=n
CONFIG_NET_VENDOR_I825XX=n
CONFIG_NET_VENDOR_MELLANOX=n
CONFIG_NET_VENDOR_MICROCHIP=n
CONFIG_NET_VENDOR_MYRI=n
CONFIG_NET_VENDOR_NATSEMI=n
CONFIG_NET_VENDOR_NETRONOME=n
CONFIG_NET_VENDOR_NVIDIA=n
CONFIG_NET_VENDOR_OKI=n
CONFIG_NET_VENDOR_8390=n
CONFIG_NET_VENDOR_QLOGIC=n
CONFIG_NET_VENDOR_REALTEK=n
CONFIG_NET_VENDOR_RENESAS=n
CONFIG_NET_VENDOR_RDC=n
CONFIG_NET_VENDOR_ROCKER=n
CONFIG_NET_VENDOR_SAMSUNG=n
CONFIG_NET_VENDOR_SILAN=n
CONFIG_NET_VENDOR_SIS=n
CONFIG_NET_VENDOR_SEEQ=n
CONFIG_NET_VENDOR_STMICRO=n
CONFIG_NET_VENDOR_SUN=n
CONFIG_NET_VENDOR_SYNOPSYS=n
CONFIG_NET_VENDOR_TEHUTI=n
CONFIG_NET_VENDOR_VIA=n
CONFIG_NET_VENDOR_WIZNET=n
#Wireless LAN
CONFIG_WLCORE=m
CONFIG_WLCORE_SDIO=m
CONFIG_WL18XX=m
CONFIG_NL80211_TESTMODE=y
CONFIG_MAC80211_MESH=y

#MDIO phys
CONFIG_MARVELL_PHY=y
CONFIG_MICREL_PHY=y
# unused PHY drivers
CONFIG_BROADCOM_PHY=n
CONFIG_ICPLUS_PHY=n
#PRU MII PHYs for Industrial Boards
CONFIG_DP83848_PHY=y
# Enable phy for DRA72 evm
CONFIG_DP83867_PHY=y
# Enable phy for AM64 evm
CONFIG_DP83869_PHY=y
# Control onboard MDIO muxes
CONFIG_MDIO_BUS_MUX_MULTIPLEXER=y

#MTD
CONFIG_MTD=y
CONFIG_MEMORY=y
CONFIG_TI_AEMIF=y
CONFIG_OMAP_GPMC=y
CONFIG_MTD_NAND_OMAP2=y
CONFIG_MTD_NAND_OMAP_BCH=y
CONFIG_MTD_NAND_OMAP_BCH_BUILD=y
CONFIG_MTD_NAND_DAVINCI=y
CONFIG_MTD_SPI_NAND=y
CONFIG_MTD_TESTS=m
CONFIG_MTD_CMDLINE_PARTS=y
CONFIG_MTD_UBI=y
CONFIG_MTD_HYPERBUS=y
CONFIG_HBMC_AM654=y

#PCIE
CONFIG_SOCIONEXT_SYNQUACER_PREITS=y
CONFIG_PCI=y
CONFIG_PCI_MSI=y
CONFIG_PCI_ENDPOINT=y
CONFIG_PCI_ENDPOINT_CONFIGFS=y
CONFIG_PCI_EPF_TEST=y
CONFIG_PCI_EPF_NTB=y
CONFIG_PCI_ENDPOINT_TEST=m
CONFIG_PCI_DRA7XX=y
CONFIG_PCI_DRA7XX_HOST=y
CONFIG_PCI_DRA7XX_EP=y
CONFIG_PCI_KEYSTONE=y
CONFIG_PCI_KEYSTONE_HOST=y
CONFIG_PCI_KEYSTONE_EP=y
CONFIG_PCI_J721E=y
CONFIG_PCI_J721E_HOST=y
CONFIG_PCI_J721E_EP=y
CONFIG_PCIE_CADENCE=y
CONFIG_PCIE_CADENCE_HOST=y
CONFIG_PCIE_CADENCE_EP=y

#NTB
CONFIG_NTB=m
CONFIG_NTB_EPF=m
CONFIG_NTB_TRANSPORT=m
CONFIG_NTB_NETDEV=m

#NVME
CONFIG_NVME_CORE=m
CONFIG_BLK_DEV_NVME=m

#These drivers have been used with DRA7x/AM57x PCIe RC with some success
CONFIG_NET_VENDOR_BROADCOM=y
CONFIG_NET_VENDOR_MARVELL=y
CONFIG_NET_VENDOR_INTEL=y
CONFIG_TIGON3=m
CONFIG_SKGE=m
CONFIG_E1000=m
CONFIG_E1000E=m
CONFIG_IWLWIFI=m
CONFIG_IWLDVM=m
CONFIG_IWLMVM=m
CONFIG_B43=m
#Generic Phys
CONFIG_PHY_AM654_SERDES=y
CONFIG_PHY_TI_KEYSTONE_SERDES=y
CONFIG_PHY_J721E_WIZ=y
CONFIG_PHY_CADENCE_SIERRA=y

# Networking
CONFIG_HSR=m
CONFIG_NF_CONNTRACK=m
CONFIG_IP_NF_IPTABLES=m
CONFIG_IP_NF_ARPTABLES=m
CONFIG_IP_NF_ARPFILTER=m
CONFIG_IP_NF_ARP_MANGLE=m
CONFIG_IP_NF_FILTER=m
CONFIG_IP_NF_NAT=m
CONFIG_IP_NF_TARGET_MASQUERADE=m
CONFIG_BRIDGE=m
CONFIG_XFRM_USER=m
CONFIG_NET_KEY=m
CONFIG_INET=y
CONFIG_INET_AH=m
CONFIG_INET6_AH=m
CONFIG_INET6_IPCOMP=m
CONFIG_INET6_XFRM_TUNNEL=m
CONFIG_INET6_TUNNEL=m
CONFIG_INET_ESP=m
CONFIG_INET_IPCOMP=m
CONFIG_IPV6_TUNNEL=m
CONFIG_NETFILTER=y
CONFIG_NETFILTER_XTABLES=m
CONFIG_NETFILTER_XT_TARGET_CLASSIFY=m
CONFIG_NETFILTER_XT_TARGET_IDLETIMER=m
CONFIG_NETFILTER_XT_TARGET_MARK=m
CONFIG_NETFILTER_XT_MATCH_COMMENT=m
CONFIG_NETFILTER_XT_MATCH_CPU=m
CONFIG_NETFILTER_XT_MATCH_IPRANGE=m
CONFIG_NETFILTER_XT_MATCH_LENGTH=m
CONFIG_NETFILTER_XT_MATCH_LIMIT=m
CONFIG_NETFILTER_XT_MATCH_MAC=m
CONFIG_NETFILTER_XT_MATCH_MARK=m
CONFIG_NETFILTER_XT_MATCH_MULTIPORT=m
CONFIG_NETFILTER_XT_MATCH_PKTTYPE=m
CONFIG_NETFILTER_XT_MATCH_POLICY=m
CONFIG_NETFILTER_XT_MATCH_SCTP=m
CONFIG_BRIDGE_NF_EBTABLES=m
CONFIG_BRIDGE_EBT_BROUTE=m
CONFIG_BRIDGE_EBT_T_FILTER=m
CONFIG_BRIDGE_EBT_T_NAT=m
CONFIG_BRIDGE_EBT_802_3=m
CONFIG_BRIDGE_EBT_AMONG=m
CONFIG_BRIDGE_EBT_ARP=m
CONFIG_BRIDGE_EBT_IP=m
CONFIG_BRIDGE_EBT_IP6=m
CONFIG_BRIDGE_EBT_LIMIT=m
CONFIG_BRIDGE_EBT_MARK=m
CONFIG_BRIDGE_EBT_PKTTYPE=m
CONFIG_BRIDGE_EBT_STP=m
CONFIG_BRIDGE_EBT_VLAN=m
CONFIG_BRIDGE_EBT_ARPREPLY=m
CONFIG_BRIDGE_EBT_DNAT=m
CONFIG_BRIDGE_EBT_MARK_T=m
CONFIG_BRIDGE_EBT_REDIRECT=m
CONFIG_BRIDGE_EBT_SNAT=m
CONFIG_BRIDGE_EBT_LOG=m
CONFIG_BRIDGE_EBT_NFLOG=m
CONFIG_NET_SCHED=y
CONFIG_NET_SCH_CBQ=m
CONFIG_NET_SCH_HTB=m
CONFIG_NET_SCH_HFSC=m
CONFIG_NET_SCH_PRIO=m
CONFIG_NET_SCH_MULTIQ=m
CONFIG_NET_SCH_RED=m
CONFIG_NET_SCH_SFB=m
CONFIG_NET_SCH_SFQ=m
CONFIG_NET_SCH_TEQL=m
CONFIG_NET_SCH_TBF=m
CONFIG_NET_SCH_GRED=m
CONFIG_NET_SCH_DSMARK=m
CONFIG_NET_SCH_NETEM=m
CONFIG_NET_SCH_DRR=m
CONFIG_NET_SCH_MQPRIO=m
CONFIG_NET_SCH_TAPRIO=m
CONFIG_NET_SCH_CHOKE=m
CONFIG_NET_SCH_QFQ=m
CONFIG_NET_SCH_CODEL=m
CONFIG_NET_SCH_FQ_CODEL=m
CONFIG_NET_SCH_INGRESS=m
CONFIG_NET_CLS=y
CONFIG_NET_CLS_BASIC=m
CONFIG_NET_CLS_TCINDEX=m
CONFIG_NET_CLS_ROUTE4=m
CONFIG_NET_CLS_FW=m
CONFIG_NET_CLS_U32=m
CONFIG_CLS_U32_MARK=y
CONFIG_NET_CLS_RSVP=m
CONFIG_NET_CLS_RSVP6=m
CONFIG_NET_CLS_FLOW=m
CONFIG_NET_EMATCH=y
CONFIG_NET_EMATCH_STACK=32
CONFIG_NET_EMATCH_CMP=m
CONFIG_NET_EMATCH_NBYTE=m
CONFIG_NET_EMATCH_U32=m
CONFIG_NET_EMATCH_META=m
CONFIG_NET_EMATCH_TEXT=m
CONFIG_NET_CLS_ACT=y
CONFIG_NET_ACT_POLICE=m
CONFIG_NET_ACT_GACT=m
CONFIG_GACT_PROB=y
CONFIG_NET_ACT_MIRRED=m
CONFIG_NET_ACT_IPT=m
CONFIG_NET_ACT_NAT=m
CONFIG_NET_ACT_PEDIT=m
CONFIG_NET_ACT_SIMP=m
CONFIG_NET_ACT_SKBEDIT=m
CONFIG_NET_ACT_CSUM=m
CONFIG_NET_SCH_FIFO=y
CONFIG_IP_SCTP=m
CONFIG_VLAN_8021Q=m
CONFIG_IP_MULTICAST=y
CONFIG_NET_SWITCHDEV=y

# Ethernet drivers
CONFIG_TI_K3_AM65_CPSW_NUSS=y
CONFIG_TI_AM65_CPSW_TAS=y
CONFIG_TI_K3_AM65_CPTS=y
#MMC/SD support
CONFIG_MMC=y
CONFIG_MMC_SDHCI=y
CONFIG_MMC_SDHCI_PLTFM=y
CONFIG_MMC_OMAP_HS=y
CONFIG_MMC_SDHCI_OMAP=y
CONFIG_MMC_DW=n
CONFIG_MMC_SDHCI_AM654=y

#SPI
CONFIG_SPI_CADENCE_QUADSPI=y
CONFIG_SPI_TI_QSPI=y
CONFIG_SPI_OMAP24XX=y
CONFIG_SPI_SLAVE=y
CONFIG_SPI_SPIDEV=m
#Disable unused SPI controllers
CONFIG_SPI_BITBANG=n
CONFIG_SPI_CADENCE=n
CONFIG_SPI_ROCKCHIP=n
CONFIG_SPI_XILINX=n

#Disable SPI NOR 4K SECTORS
CONFIG_MTD_SPI_NOR_USE_4K_SECTORS=n

#SPI GPIO expanders
CONFIG_GPIO_PISOSR=m

#SATA
CONFIG_SATA_AHCI_PLATFORM=m
CONFIG_SATA_AHCI=m
CONFIG_ATA=m

#USB PHY
CONFIG_OMAP_USB2=m

#USB gadgets
CONFIG_USB_GADGET=m
CONFIG_USB_AUDIO=m
CONFIG_USB_ETH=m
CONFIG_USB_G_NCM=m
CONFIG_USB_GADGETFS=m
CONFIG_USB_FUNCTIONFS=m
CONFIG_USB_FUNCTIONFS_ETH=y
CONFIG_USB_FUNCTIONFS_RNDIS=y
CONFIG_USB_FUNCTIONFS_GENERIC=y
CONFIG_USB_MASS_STORAGE=m
CONFIG_USB_G_SERIAL=m
CONFIG_USB_MIDI_GADGET=m
CONFIG_USB_G_PRINTER=m
CONFIG_USB_CDC_COMPOSITE=m
CONFIG_USB_G_ACM_MS=m
CONFIG_USB_G_MULTI=m
CONFIG_USB_G_MULTI_CDC=y
CONFIG_USB_G_HID=m
CONFIG_USB_G_DBGP=m
CONFIG_USB_G_WEBCAM=m
CONFIG_USB_GADGET_STORAGE_NUM_BUFFERS=32
CONFIG_USB_ZERO=m
CONFIG_USB_CONFIGFS=m
CONFIG_USB_CONFIGFS_SERIAL=y
CONFIG_USB_CONFIGFS_ACM=y
CONFIG_USB_CONFIGFS_OBEX=y
CONFIG_USB_CONFIGFS_NCM=y
CONFIG_USB_CONFIGFS_ECM=y
CONFIG_USB_CONFIGFS_ECM_SUBSET=y
CONFIG_USB_CONFIGFS_RNDIS=y
CONFIG_USB_CONFIGFS_EEM=y
CONFIG_USB_CONFIGFS_MASS_STORAGE=y
CONFIG_USB_CONFIGFS_F_LB_SS=y
CONFIG_USB_CONFIGFS_F_FS=y
CONFIG_USB_CONFIGFS_F_UAC1=y
CONFIG_USB_CONFIGFS_F_UAC2=y
CONFIG_USB_CONFIGFS_F_MIDI=y
CONFIG_USB_CONFIGFS_F_HID=y
CONFIG_USB_CONFIGFS_F_UVC=y
CONFIG_USB_CONFIGFS_F_PRINTER=y

# USB DWC3
CONFIG_USB_DWC3=m
CONFIG_USB_DWC3_DUAL_ROLE=y
CONFIG_USB_DWC3_OMAP=m
CONFIG_USB_DWC3_KEYSTONE=m
CONFIG_USB_DWC3_AM62=m
CONFIG_USB_DWC3_PCI=n
CONFIG_USB_DWC2=n
CONFIG_USB_CHIPIDEA=n

# USB CDNS3
CONFIG_USB_CDNS3=m
CONFIG_USB_CDNS3_GADGET=y
CONFIG_USB_CDNS3_HOST=y
CONFIG_USB_CDNS3_TI=m

#USB PHY
CONFIG_NOP_USB_XCEIV=m

#USB MUSB
CONFIG_USB_MUSB_HDRC=m
CONFIG_USB_MUSB_DUAL_ROLE=y
CONFIG_USB_MUSB_OMAP2PLUS=m
CONFIG_USB_MUSB_AM35X=m
CONFIG_USB_MUSB_DSPS=m
CONFIG_USB_MUSB_AM335X_CHILD=m
CONFIG_TI_CPPI41=y
CONFIG_USB_TI_CPPI41_DMA=y
CONFIG_AM335X_CONTROL_USB=y
CONFIG_AM335X_PHY_USB=y

#USB EHCI
CONFIG_USB=m
CONFIG_USB_EHCI_HCD=m
CONFIG_USB_EHCI_PCI=m
CONFIG_USB_EHCI_HCD_OMAP=m

#USB Networking
CONFIG_USB_NET_DRIVERS=m
CONFIG_USB_PEGASUS=m
CONFIG_USB_RTL8150=m
CONFIG_USB_RTL8152=m
CONFIG_USB_LAN78XX=m
CONFIG_USB_USBNET=m
CONFIG_USB_NET_AX8817X=m
CONFIG_USB_NET_AX88179_178A=m
CONFIG_USB_NET_CDCETHER=m
CONFIG_USB_NET_CDC_EEM=m
CONFIG_USB_NET_CDC_NCM=m
CONFIG_USB_NET_SMSC75XX=m
CONFIG_USB_NET_SMSC95XX=m
CONFIG_USB_NET_NET1080=m
CONFIG_USB_NET_CDC_SUBSET_ENABLE=m
CONFIG_USB_NET_CDC_SUBSET=m
CONFIG_USB_BELKIN=y
CONFIG_USB_ARMLINUX=y
CONFIG_USB_NET_ZAURUS=m

#USB testing
CONFIG_USB_TEST=m
CONFIG_USB_ANNOUNCE_NEW_DEVICES=y

#USB Serial
CONFIG_USB_ACM=m
CONFIG_USB_SERIAL=m
CONFIG_USB_SERIAL_CP210X=m
CONFIG_USB_SERIAL_FTDI_SIO=m
CONFIG_USB_SERIAL_PL2303=m
CONFIG_USB_SERIAL_OPTION=m

# Extcon drivers
CONFIG_EXTCON=m
CONFIG_EXTCON_PALMAS=m
CONFIG_EXTCON_USB_GPIO=m

# USB PD controller drivers
CONFIG_TYPEC_TPS6598X=m

# PWM
CONFIG_PWM_TIECAP=y
CONFIG_PWM_TIEHRPWM=y
CONFIG_PWM_TIPWMSS=y
CONFIG_PWM_OMAP_DMTIMER=y

# eCAP driver
CONFIG_TI_ECAP_CAPTURE=m

# 1-wire Bus Masters
CONFIG_W1=m
CONFIG_HDQ_MASTER_OMAP=m

# Matrix keypad
CONFIG_KEYBOARD_MATRIX=m

#Touchscreen/ADC
CONFIG_TOUCHSCREEN_PIXCIR=m
CONFIG_MFD_TI_AM335X_TSCADC=m
CONFIG_TOUCHSCREEN_TI_AM335X_TSC=m
CONFIG_TI_AM335X_ADC=m

#CAN
CONFIG_CAN=m
CONFIG_CAN_C_CAN=m
CONFIG_CAN_C_CAN_PLATFORM=m
CONFIG_CAN_M_CAN=m
CONFIG_CAN_M_CAN_PLATFORM=m

# CAN Transceiver
CONFIG_PHY_CAN_TRANSCEIVER=m

# Rotary Encoder
CONFIG_INPUT_GPIO_DECODER=m

# Filesystem extra options
CONFIG_EXT4_FS_POSIX_ACL=y
CONFIG_EXT4_FS_SECURITY=y
CONFIG_CIFS=m
CONFIG_CIFS_STATS=y
CONFIG_CIFS_XATTR=y
CONFIG_CIFS_POSIX=y
CONFIG_UBIFS_FS=y

# HD-Audio
CONFIG_SND_USB=y
CONFIG_SND_USB_AUDIO=m

#UFS
CONFIG_SCSI=y
CONFIG_BLK_DEV_SD=y
CONFIG_SCSI_UFSHCD=y
CONFIG_SCSI_UFS_BSG=y
CONFIG_SCSI_UFSHCD_PLATFORM=y
CONFIG_SCSI_UFS_CDNS_PLATFORM=y
CONFIG_SCSI_UFS_TI_J721E=y

#PRUSS-UART
CONFIG_SERIAL_8250_PRUSS=m

# MUX Drivers
CONFIG_MUX_GPIO=y

# PRU Soft UART driver
CONFIG_SERIAL_PRU_SWUART=m

# Enable Power line communication Common drivers
CONFIG_NET_VENDOR_QUALCOMM=y
CONFIG_QCA7000=m
CONFIG_QCA7000_SPI=m
CONFIG_QCA7000_UART=m

# AF_XDP
CONFIG_BPF_SYSCALL=y
CONFIG_XDP_SOCKETS=y

##################################################
# TI Audio/Display config options
##################################################

CONFIG_CMA=y
CONFIG_DMA_CMA=y
CONFIG_CMA_SIZE_MBYTES=512

# backlight

CONFIG_LEDS_CLASS=y
CONFIG_LEDS_TLC591XX=y

CONFIG_BACKLIGHT_PWM=y
CONFIG_BACKLIGHT_GPIO=y
CONFIG_BACKLIGHT_LED=y

# fbdev

CONFIG_FB_SSD1307=y
CONFIG_FRAMEBUFFER_CONSOLE=y
CONFIG_DRM_MIPI_DBI=m
CONFIG_TINYDRM_ILI9225=m

# DRM
CONFIG_DRM=y
CONFIG_DRM_PANEL_SIMPLE=y
CONFIG_DRM_PANEL_OSD_OSD101T2587_53TS=y
CONFIG_DRM_DISPLAY_CONNECTOR=y
CONFIG_DRM_LVDS_CODEC=y
CONFIG_DRM_SII902X=y
CONFIG_DRM_TOSHIBA_TC358767=y
CONFIG_DRM_TOSHIBA_TC358768=y
CONFIG_DRM_TI_TFP410=y
CONFIG_DRM_TI_TPD12S015=y

# Firmware loading only works if built as module
CONFIG_DRM_CDNS_MHDP8546=m
CONFIG_DRM_CDNS_DSI=m

CONFIG_PHY_J721E_WIZ=y
CONFIG_PHY_CADENCE_TORRENT=y

# SGX driver needs legacy support
CONFIG_DRM_LEGACY=y

CONFIG_DRM_I2C_NXP_TDA998X=y

# tidss
CONFIG_DRM_TIDSS=y

# Touchscreen
CONFIG_TOUCHSCREEN_GOODIX=m
CONFIG_TOUCHSCREEN_ILI210X=m
CONFIG_TOUCHSCREEN_EDT_FT5X06=m
CONFIG_HID_MULTITOUCH=m

# V4L2
CONFIG_VIDEO_CADENCE=y
CONFIG_VIDEO_CADENCE_CSI2RX=m
CONFIG_VIDEO_TI_CAL=m
CONFIG_VIDEO_TI_J721E_CSI2RX=m
CONFIG_VIDEO_IMX390=m
CONFIG_VIDEO_OV2659=m
CONFIG_VIDEO_OV5640=m
CONFIG_VIDEO_OV1063X=m
CONFIG_VIDEO_OV2312=m
CONFIG_VIDEO_DS90UB953=m
CONFIG_VIDEO_DS90UB960=m
CONFIG_PHY_CADENCE_DPHY=m

# Sound
CONFIG_SND_SOC_DAVINCI_MCASP=y
CONFIG_SND_SOC_J721E_EVM=m
CONFIG_SND_SOC_SIMPLE_AMPLIFIER=m
CONFIG_SND_SOC_TLV320AIC31XX=m
CONFIG_SND_SOC_TLV320AIC3X=m

# display sharing
CONFIG_RPMSG_KDRV_DISPLAY=y

##################################################
# TI Multimedia (Video Decode, Encode) Configs
##################################################

# IMG D5500 v4l2 Driver Config Options
CONFIG_MEDIA_SUPPORT=y
CONFIG_VIDEO_IMG_VXD_DEC=m

# IMG VXE384 v4l2 Driver Config Options
CONFIG_VIDEO_IMG_VXE_ENC=m

# Enable multimedia staging drivers for Wave VPU driver.
CONFIG_STAGING_MEDIA=y
CONFIG_VIDEO_WAVE_VPU=m

##############################################
#
# Kernel options needed for systemd enabled TI SDKs
# See https://cgit.freedesktop.org/systemd/systemd/tree/README#n38 for details
#
##############################################
CONFIG_TMPFS=y
CONFIG_DEVTMPFS=y
CONFIG_DEVTMPFS_MOUNT=y
CONFIG_CGROUPS=y
CONFIG_CGROUP_FREEZER=y
CONFIG_CGROUP_DEVICE=y
CONFIG_CGROUP_CPUACCT=y
CONFIG_BLK_CGROUP=y
CONFIG_CGROUP_PIDS=y
CONFIG_CGROUP_PERF=y

CONFIG_INOTIFY_USER=y
CONFIG_SIGNALFD=y
CONFIG_TIMERFD=y
CONFIG_EPOLL=y
CONFIG_NET=y
CONFIG_SYSFS=y
CONFIG_PROC_FS=y
CONFIG_FHANDLE=y

# udev will fail to work with the legacy sysfs layout:
CONFIG_SYSFS_DEPRECATED=n

# Legacy hotplug slows down the system and confuses udev:
CONFIG_UEVENT_HELPER_PATH=""

# Userspace firmware loading is not supported and should
# be disabled in the kernel:
CONFIG_FW_LOADER_USER_HELPER=n

# Some udev rules and virtualization detection relies on it:
# Only for UEFI based systems
# http://cateee.net/lkddb/web-lkddb/DMI.html
CONFIG_DMIID=n

# Support for some SCSI devices serial number retrieval, to
# create additional symlinks in /dev/disk/ and /dev/tape:
CONFIG_BLK_DEV_BSG=y

# Required for PrivateNetwork and PrivateDevices in service units:
# Note that systemd-localed.service and other systemd units use
# PrivateNetwork and PrivateDevices so this is effectively required.
CONFIG_NAMESPACES=y
CONFIG_NET_NS=y
CONFIG_DEVPTS_MULTIPLE_INSTANCES=y

# Optional but strongly recommended options: those are nice to have and
# indeed recommended, but not necessarily systemd required. These to be
# enabled in corresponding domain fragments since they are not specific
# to supporting systemd.

CONFIG_SECCOMP=y
# for kcmp syscall
CONFIG_CHECKPOINT_RESTORE=y

# Required for CPUShares= in resource control unit settings
CONFIG_CGROUP_SCHED=y
CONFIG_FAIR_GROUP_SCHED=y

# Required for CPUQuota= in resource control unit settings
CONFIG_CFS_BANDWIDTH=y

# For systemd-bootchart, several proc debug interfaces are required:
# Systemd-debug.cfg?
CONFIG_SCHEDSTATS=y
CONFIG_SCHED_DEBUG=y

# We recommend to turn off Real-Time group scheduling in the
# kernel when using systemd. RT group scheduling effectively
# makes RT scheduling unavailable for most userspace, since it
# requires explicit assignment of RT budgets to each unit whose
# processes making use of RT. As there's no sensible way to
# assign these budgets automatically this cannot really be
# fixed, and it's best to disable group scheduling hence.
CONFIG_RT_GROUP_SCHED=n

# Note that kernel auditing is broken when used with systemd's
# container code. When using systemd in conjunction with
# containers, please make sure to either turn off auditing at
# runtime using the kernel command line option "audit=0", or
# turn it off at kernel compile time using:
CONFIG_AUDIT=n

##############################################
#
# Kernel options needed for container enabled TI SDKs
# See https://raw.githubusercontent.com/moby/moby/v20.10.12/contrib/check-config.sh
# Also see lxc-checkconfig
#
##############################################

# Just the basic container configuration necessary
CONFIG_CGROUP_BPF=y
CONFIG_VETH=m
CONFIG_BRIDGE_NETFILTER=m
CONFIG_NETFILTER_XT_MATCH_ADDRTYPE=m
CONFIG_NETFILTER_XT_MATCH_CONNTRACK=m
CONFIG_NETFILTER_XT_MATCH_IPVS=m
CONFIG_NET_CLS_CGROUP=m
CONFIG_IP_VS=m
CONFIG_IP_VS_RR=m
CONFIG_VXLAN=m
CONFIG_IPVLAN=m
CONFIG_MACVLAN=m
CONFIG_DUMMY=m
CONFIG_NF_NAT_FTP=m
CONFIG_NF_CONNTRACK_FTP=m
CONFIG_NF_NAT_TFTP=m
CONFIG_NF_CONNTRACK_TFTP=m
CONFIG_AUFS_FS=m
CONFIG_BTRFS_FS=m
CONFIG_BLK_DEV_DM=m
CONFIG_DM_THIN_PROVISIONING=m
CONFIG_OVERLAY_FS=m
CONFIG_INET_XFRM_MODE_TRANSPORT=m
```
